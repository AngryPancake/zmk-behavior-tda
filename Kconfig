## Kconfig
```kconfig
# SPDX-License-Identifier: MIT

DT_COMPAT_ZMK_BEHAVIOR_TDA := zmk,behavior-tda

config ZMK_BEHAVIOR_TDA
    bool "Tap Dance Advanced behavior"
    default $(dt_compat_enabled,$(DT_COMPAT_ZMK_BEHAVIOR_TDA))
    help
      Advanced Tap Dance that triggers the first action immediately and upgrades on further taps.

config ZMK_BEHAVIOR_TDA_MAX_HELD
    int "Maximum simultaneously held TDA keys"
    default 4
```

## app/dts/bindings/behaviors/zmk,behavior-tda.yaml
```yaml
# SPDX-License-Identifier: MIT
description: Tap Dance Advanced behavior for ZMK

compatible: "zmk,behavior-tda"

include:
  - zmk,behavior-base.yaml

properties:
  tapping-term-ms:
    type: int
    required: true
    description: Time window in milliseconds to detect multiple taps.
  bindings:
    type: phandles
    required: true
    description: List of behaviors for each tap count.
```

## dts/bindings/behaviors/zmk,behavior-tda.yaml
```yaml
# SPDX-License-Identifier: MIT
description: Advanced Tap Dance behavior for ZMK

compatible: "zmk,behavior-tda"

# include: one_param.yaml
include: no_params.yaml


properties:
  tapping-term-ms:
    type: int
    required: false
    description: "Tap dance timeout (ms)"
  bindings:
    type: phandle-array
    required: true
    description: "Bindings for tap and hold actions"
```

## west.yml
```yaml
manifest:
  remotes:
    - name: AngryPancake
      url-base: https://github.com/AngryPancake
  projects:
    # Together with the above defined remote, this refers to a module located at
    # https://github.com/remote-name/repository-name
    - name: zmk-behavior-tda
      remote: AngryPancake
      # This points to a west manifest file in the remote module for further imports
      import: west.yml
```
